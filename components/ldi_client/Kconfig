## components/ldi_client/Kconfig
```kconfig
menu "Bosch bridge"

    config BRIDGE_ENABLE_LDI
        bool "Build the Bosch LDI central (bike side)"
        default y
        help
            When disabled, a no-op stub is linked instead and the firmware
            runs as a watch-only CPS peripheral with no dependency on the
            Bosch specification. Phase 1 shipped with this off.

    config BRIDGE_DLE_BEFORE_MTU
        bool "Request data length extension before the ATT MTU exchange"
        default y
        help
            Negotiating a large ATT MTU while the link-layer payload is still
            27 octets forces L2CAP fragmentation. That should work, but it is
            the configuration under which truncation was reported against
            early bike firmware. Flip this during bring-up if the bike
            dislikes the order.

    config BRIDGE_MIN_ATT_MTU
        int "Minimum acceptable negotiated ATT MTU on the bike link"
        default 100
        range 23 517

    config BRIDGE_MIN_LL_RX_OCTETS
        int "Minimum acceptable negotiated LL max_rx_octets on the bike link"
        default 100
        range 27 251
        help
            RX, not TX: the bike's notifications arrive on our receive path,
            so a wide TX with a narrow RX still truncates the stream.

    config BRIDGE_LINK_VERIFY_TIMEOUT_MS
        int "Timeout waiting for DATA_LEN_CHG / MTU"
        default 3000
        range 500 20000

    config BRIDGE_CAPTURE_PAYLOAD_MS
        int "Minimum interval between captured notification payloads (ms)"
        default 1000
        range 0 60000
        help
            While riding, the bike notifies at roughly 4 Hz. Capturing every
            payload means a synchronous flash write per notification from the
            NimBLE host task, plus a blocking 4 KB sector erase every few
            seconds -- around 1.45 MB of writes per 80-minute ride.

            1 Hz is ample for protocol analysis. Set to 0 to capture every
            frame when reverse-engineering a bike whose behaviour differs.
            Events are always captured in full regardless.

    config BRIDGE_MAX_DISCOVERED_CHRS
        int "Maximum characteristics recorded during discovery"
        default 32
        range 8 128

    config BRIDGE_VALUE_HOLD_MS
        int "How long a rider power / cadence value stays usable (ms)"
        default 15000
        range 1000 120000
        help
            LDI omits a field when it has not changed (spec 2.2.4.3), so
            "no update" means "unchanged", not "gone".

            Measured over two full rides: the bike notifies at ~5.1 Hz, but
            rider power appears in only 5.3-6.5% of frames and cadence in
            4.2-5.5% -- one update every 3.0-3.7 s and 3.5-4.8 s respectively,
            and longer the steadier the riding, because nothing changes.

            The previous value here was 3000, SHORTER than the bike's own
            spacing, so both fields aged out between legitimate updates and the
            bridge reported 0 W for roughly half of every ride even with a
            perfect link. Holding is safe because change is what triggers a
            send: stopping pedalling, or any new value, arrives promptly. The
            residual risk this bounds is spec 2.2.3.2 -- a data source that
            vanishes silently -- and BRIDGE_BIKE_SILENT_MS bounds it further.

    config BRIDGE_BIKE_SILENT_MS
        int "No LDI frame at all for this long means the bike is gone (ms)"
        default 8000
        range 1000 60000
        help
            Judged on odometer and standstill, which the bike puts in 100% of
            frames -- unlike power and cadence. Below this the bridge keeps
            notifying; above it, it stops entirely rather than sending zeros
            the watch would record as measurements.

    config BRIDGE_RANDOM_STATIC_ADDR
        bool "Advertise from a static random address instead of the public one"
        default y
        help
            The eBike sends a connection request that never reaches our host,
            and afterwards believes itself connected: it stops offering the
            bridge until the BIKE is power-cycled, while power-cycling the
            bridge changes nothing. A CONNECT_IND whose address type does not
            match the advertiser is discarded in the link layer, below HCI --
            invisible to the peripheral, and leaving the initiator thinking it
            succeeded. That is this symptom exactly.

            The public address begins 0x9C = 1001 1100. Top two bits 10 is a
            valid PUBLIC address but not a valid random one (static needs 11).
            Anything treating it as random produces the failure above; this
            option sets the top two bits so the address is unambiguous.

            Derived from the public address, so it is stable across reboots.
            Changing it COSTS THE WATCH ITS PAIRING -- watches key their
            remembered-sensor list on the address, so forget and re-pair the
            pod after flipping this either way.

    config BRIDGE_LED_GPIO
        int "Status LED GPIO"
        default 8

    config BRIDGE_LED_ACTIVE_LOW
        bool "Status LED is active low"
        default y
        help
            Confirmed active low on the ESP32-C3 SuperMini.

endmenu
```
